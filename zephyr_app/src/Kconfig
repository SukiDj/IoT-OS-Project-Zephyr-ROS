## zephyr_app/src/Kconfig
```kconfig
config FAN_ACTUATOR
	bool "Fan actuator driver"
	default y
	depends on GPIO
	help
	  Enable the custom fan actuator driver.
```

## zephyr_app/tests/testcase.yaml
```yaml
tests:
  iot_app.actuator_logic.ztest:
    build_only: false
    platform_allow:
      - native_sim
    integration_platforms:
      - native_sim
    tags: test_framework
```
